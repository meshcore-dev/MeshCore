## CMakeLists.txt
```
# MeshCore "minimal" Zephyr sample.
#
# Brings up the mesh core with the Zephyr platform helpers and a loopback radio,
# proving the engine compiles and runs on a Zephyr target with no external
# radio hardware or extra dependencies.
cmake_minimum_required(VERSION 3.20.0)

find_package(Zephyr REQUIRED HINTS $ENV{ZEPHYR_BASE})
project(meshcore_mesh_min)

target_sources(app PRIVATE src/main.cpp)

# The MeshCore module publishes its own include paths via zephyr_include_directories.
```

## sample.yaml
```
sample:
  name: MeshCore minimal (loopback)
  description: >
    Brings up the MeshCore mesh engine on Zephyr with the Zephyr platform
    helpers and a loopback radio. No external LoRa hardware required.

common:
  tags: meshcore lora mesh
  integration_platforms:
    - native_sim
  harness: console
  harness_config:
    type: one_line
    regex:
      - "MeshCore minimal sample: mesh engine up"

tests:
  sample.meshcore.mesh_min:
    platform_allow:
      - native_sim
      - qemu_cortex_m3
```

## prj.conf
```kconfig
# Minimal MeshCore sample configuration.

# Pull in and build the MeshCore library.
CONFIG_MESHCORE=y
CONFIG_MESHCORE_ARDUINO_COMPAT=y
CONFIG_MESHCORE_ZEPHYR_HELPERS=y

# No persistent storage in this sample: the identity is volatile and regenerated
# on each boot. This is also what a board with no spare flash partition would use.
CONFIG_MESHCORE_STORAGE=n

# C++ runtime.
CONFIG_CPP=y
CONFIG_STD_CPP17=y

# Randomness for the RNG binding. XOSHIRO is the PRNG behind sys_rand_get() when
# no hardware entropy source is available (native_sim); CONFIG_TEST_RANDOM_GENERATOR
# was the old spelling and is gone in current Zephyr.
CONFIG_ENTROPY_GENERATOR=y
CONFIG_XOSHIRO_RANDOM_GENERATOR=y

# Console / logging.
CONFIG_PRINTK=y
CONFIG_LOG=y

# Reasonable stack/heap headroom for the mesh engine.
CONFIG_MAIN_STACK_SIZE=4096
CONFIG_HEAP_MEM_POOL_SIZE=16384
```

## src/main.cpp
```c
//
// MeshCore minimal Zephyr sample.
//
// Instantiates the MeshCore engine on Zephyr using the bundled platform helpers
// (clock, RNG, RTC, board) and a loopback radio, then runs the dispatcher loop.
// This proves the core builds and runs on a Zephyr target with no external LoRa
// hardware. Swap LoopbackRadio for a RadioLib-backed driver (see
// ports/zephyr/RadioLibZephyrHal.h) to talk to real hardware.
//
#include <Arduino.h>
#include <Mesh.h>
#include <MeshCoreZephyr.h>
#include <helpers/StaticPoolPacketManager.h>
#include <helpers/SimpleMeshTables.h>

#include <zephyr/kernel.h>

// --- A do-nothing radio: accepts sends, never receives -------------------
class LoopbackRadio : public mesh::Radio {
public:
  int recvRaw(uint8_t*, int) override { return 0; }
  uint32_t getEstAirtimeFor(int len_bytes) override { return len_bytes; /* ~1ms/byte */ }
  float packetScore(float, int) override { return 0.0f; }
  bool startSendRaw(const uint8_t*, int) override { return true; }
  bool isSendComplete() override { return true; }
  void onSendFinished() override {}
  bool isInRecvMode() const override { return true; }
};

// --- Platform bindings (Zephyr-backed) -----------------------------------
static LoopbackRadio               radio;
static mesh_zephyr::ZephyrMillisClock ms_clock;
static mesh_zephyr::ZephyrRNG       rng;
static mesh_zephyr::ZephyrRTCClock  rtc;
static StaticPoolPacketManager      pool(16);
static SimpleMeshTables             tables;

// --- The mesh engine ------------------------------------------------------
class MinimalMesh : public mesh::Mesh {
public:
  MinimalMesh()
    : mesh::Mesh(radio, ms_clock, rng, rtc, pool, tables) {}
};

static MinimalMesh the_mesh;

int main(void) {
  Serial.begin(115200);

  // Give this node a fresh random identity, then start the dispatcher.
  the_mesh.self_id = mesh::LocalIdentity(&rng);
  the_mesh.begin();

  Serial.println("MeshCore minimal sample: mesh engine up");

  for (;;) {
    the_mesh.loop();
    k_msleep(10);
  }
  return 0;
}
```
